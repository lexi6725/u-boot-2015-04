## arch/arm/cpu/arm1176/s3c64xx/Kconfig
```kconfig
if ARCH_S3C64XX

choice
	prompt "S3C64XX board select"

config TARGET_SMDK6410
	bool "Support smdk6410 board"
	select OF_CONTROL

endchoice

config SYS_SOC
	default "s3c64xx"

source "board/samsung/smdk6410/Kconfig"

endif
```

## board/samsung/smdk6410/Kconfig
```kconfig
if TARGET_SMDK6410

config SYS_BOARD
	default "smdk6410"

config SYS_VENDOR
	default "samsung"

config SYS_SOC
	default "s3c64xx"

config SYS_CONFIG_NAME
	default "smdk6410"

endif
```

## configs/smdk6410_defconfig
```kconfig
CONFIG_ARM=y
CONFIG_TARGET_SMDK6410=y
CONFIG_ARCH_S3C64XX=y
CONFIG_DEFAULT_DEVICE_TREE="s3c64xx-smdk6410"
```
